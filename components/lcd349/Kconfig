## components/lcd349/Kconfig
```kconfig
menu "lcd349 board SDK"

    choice LCD349_BOARD_REV
        prompt "Board revision"
        default LCD349_BOARD_REV_V1
        help
            V1 boards have no touch interrupt line; V2 boards expose TP_INT,
            which can replace polling while the screen is on. The revision is
            on the board's silkscreen.

        config LCD349_BOARD_REV_V1
            bool "V1 (no touch interrupt)"
        config LCD349_BOARD_REV_V2
            bool "V2 (TP_INT)"
    endchoice

    config LCD349_LIGHT_SLEEP
        bool "Light sleep in lcd349_sleep_until_button (esp_pm, tickless idle)"
        depends on !IDF_TARGET_LINUX
        default y
        select PM_ENABLE
        select FREERTOS_USE_TICKLESS_IDLE
        help
            lcd349_sleep_until_button puts the board into light sleep through
            esp_pm with tickless idle (requirement 4.2), allowing it only for
            the call. That needs power management and tickless idle, which
            this option turns on, so every product gets them without setting
            them itself. Without it, lcd349_sleep_until_button returns
            LCD349_ERR_UNAVAILABLE. Power management adds a little interrupt
            latency and idle-entry time (ESP-IDF's PM_ENABLE help).

            Leave USJ_NO_AUTO_LS_ON_CONNECTION off (its default): with it on,
            the board never sleeps while USB is connected. Design D1-11.

    config LCD349_HIL
        bool "Hardware in the loop over the USB serial console (Phase 1.5; not implemented yet)"
        depends on !IDF_TARGET_LINUX
        default n
        help
            Accept control requests (info, screenshot, input, wait) as
            prefixed lines on the USB serial console, so the lcd349 CLI and
            MCP tools can drive the real board. Requirement 14; task 11.1.

endmenu
```

## components/lcd349/test_apps/board/sdkconfig.defaults
```kconfig
CONFIG_IDF_TARGET="esp32s3"
CONFIG_ESPTOOLPY_FLASHSIZE_16MB=y
CONFIG_ESPTOOLPY_FLASHMODE_QIO=y
CONFIG_ESPTOOLPY_FLASHFREQ_80M=y
CONFIG_SPIRAM=y
CONFIG_SPIRAM_MODE_OCT=y
CONFIG_SPIRAM_SPEED_80M=y
CONFIG_ESP_DEFAULT_CPU_FREQ_MHZ_240=y
CONFIG_ESP_CONSOLE_USB_SERIAL_JTAG=y
CONFIG_FREERTOS_HZ=1000
CONFIG_PARTITION_TABLE_SINGLE_APP_LARGE=y
CONFIG_COMPILER_OPTIMIZATION_PERF=y
CONFIG_LV_COLOR_DEPTH_16=y
CONFIG_LV_FONT_MONTSERRAT_14=y
# The tests run on the main task.
CONFIG_ESP_MAIN_TASK_STACK_SIZE=16384
```

## components/lcd349/test_apps/build_check/sdkconfig.defaults.esp32s3
```kconfig
CONFIG_SPIRAM=y
CONFIG_SPIRAM_MODE_OCT=y
CONFIG_ESPTOOLPY_FLASHSIZE_16MB=y
CONFIG_PARTITION_TABLE_SINGLE_APP_LARGE=y
```

## components/lcd349/test_apps/host/sdkconfig.defaults
```kconfig
CONFIG_IDF_TARGET="linux"
CONFIG_UNITY_ENABLE_IDF_TEST_RUNNER=n
CONFIG_FREERTOS_HZ=1000
CONFIG_LV_COLOR_DEPTH_16=y
CONFIG_LV_FONT_MONTSERRAT_14=y
CONFIG_LV_FONT_MONTSERRAT_8=y
```
